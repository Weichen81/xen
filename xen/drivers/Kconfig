## xen/drivers/Kconfig
```kconfig
menu "Device Drivers"

source "drivers/acpi/Kconfig"

source "drivers/char/Kconfig"

source "drivers/cpufreq/Kconfig"

source "drivers/passthrough/Kconfig"

source "drivers/pci/Kconfig"

source "drivers/video/Kconfig"

config HAS_VPCI
	bool

config VIRTIO
	bool "VIRTIO support"
	default y
	depends on ARM_64
	select IOREQ_SERVER
	help
	  VIRTIO transprot support.

endmenu
```
